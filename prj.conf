## CMakeLists.txt
```
cmake_minimum_required(VERSION 3.20.0)

if(BOARD STREQUAL "nrf7002dk/nrf5340/cpuapp")
  set(DTC_OVERLAY_FILE "${CMAKE_CURRENT_SOURCE_DIR}/nrf7002dk_nrf5340_cpuapp.overlay")
elseif(BOARD STREQUAL "nrf52840dk/nrf52840")
  set(DTC_OVERLAY_FILE "${CMAKE_CURRENT_SOURCE_DIR}/nrf52840dk_nrf52840.overlay")
endif()

find_package(Zephyr REQUIRED HINTS $ENV{ZEPHYR_BASE})

project(Nordic_OTA)

target_sources(app PRIVATE src/main.c)
target_sources(app PRIVATE
    src/tls_common.c
    src/wifi_net.c
    src/ntp_sync.c
    src/ota_manifest.c
    src/ota_download.c
    src/mqtt_ctrl.c
)
```

## sysbuild.conf
```
# ── sysbuild.conf (project root, alongside CMakeLists.txt) ───────────────────
# Processed by west/sysbuild before the application Kconfig.
# SB_CONFIG_ prefix = sysbuild-level symbol; never put these in prj.conf.

# Enable MCUboot as a child image. Sysbuild compiles it separately and wires
# it into the flash layout via Partition Manager.
SB_CONFIG_BOOTLOADER_MCUBOOT=y

# Place the secondary slot (OTA download target) in external QSPI flash.
#
# Internal flash (1 MB) layout after this change:
#   MCUboot bootloader  ~64 KB
#   Primary slot        ~928 KB   ← running firmware lives here
#   NVS / storage        ~32 KB
#
# External QSPI flash (8 MB) layout:
#   Secondary slot      ~928 KB   ← downloaded firmware lands here
#   Remaining ~7 MB     free (logs, assets, future use)
#
# This almost doubles usable per-slot firmware space versus the original
# two-slot-in-internal-flash design. Flash budget constraint is lifted.
SB_CONFIG_PM_EXTERNAL_FLASH_MCUBOOT_SECONDARY=y
SB_CONFIG_WIFI_NRF70=y
```

## prj.conf
```kconfig
# =============================================================================
# prj.conf — OTA Client, Stage 7 (MCUboot + External QSPI Flash Download)
# Target : nrf7002dk/nrf5340/cpuapp     NCS : v2.9.2 / Zephyr 3.7.x
# =============================================================================

# ── Wi-Fi ─────────────────────────────────────────────────────────────────────
CONFIG_WIFI=y
CONFIG_WIFI_NRF70=y
CONFIG_WIFI_NM_WPA_SUPPLICANT=y

# ── Wi-Fi Credentials & Auto-Connect ─────────────────────────────────────────
CONFIG_WIFI_CREDENTIALS=y
CONFIG_WIFI_CREDENTIALS_STATIC=y
CONFIG_WIFI_CREDENTIALS_STATIC_SSID="STECH"
CONFIG_WIFI_CREDENTIALS_STATIC_PASSWORD="$tech1311"
CONFIG_NET_CONNECTION_MANAGER=y
CONFIG_L2_WIFI_CONNECTIVITY=y
CONFIG_L2_WIFI_CONNECTIVITY_AUTO_CONNECT=y

# ── Networking Stack ──────────────────────────────────────────────────────────
CONFIG_NETWORKING=y
CONFIG_NET_SOCKETS=y
CONFIG_NET_L2_ETHERNET=y
CONFIG_NET_IPV4=y
CONFIG_NET_IPV6=n
CONFIG_NET_DHCPV4=y
CONFIG_NET_TCP=y
CONFIG_NET_UDP=y
CONFIG_NET_MGMT_EVENT_INFO=y

# ── MQTT ──────────────────────────────────────────────────────────────────────
CONFIG_MQTT_LIB=y
CONFIG_MQTT_CLEAN_SESSION=y
CONFIG_MQTT_LIB_TLS=y

# ── DNS ───────────────────────────────────────────────────────────────────────
CONFIG_DNS_RESOLVER=y
CONFIG_DNS_RESOLVER_ADDITIONAL_BUF_CTR=5

# ── TLS ───────────────────────────────────────────────────────────────────────
CONFIG_NET_SOCKETS_SOCKOPT_TLS=y
# Two contexts: one for manifest fetch, one for firmware download.
# Both are sequential (never simultaneous), but the OS may not release
# the context instantly after close(). Two prevents ENOBUFS on rapid retries.
CONFIG_NET_SOCKETS_TLS_MAX_CONTEXTS=4
CONFIG_TLS_CREDENTIALS=y
CONFIG_MBEDTLS_SSL_SERVER_NAME_INDICATION=y

# ── nRF Security (PSA backend) ────────────────────────────────────────────────
CONFIG_NRF_SECURITY=y
CONFIG_NRF_SECURITY_ADVANCED=y
CONFIG_MBEDTLS_ECP_DP_SECP384R1_ENABLED=y
CONFIG_PSA_WANT_ECC_SECP_R1_384=y
CONFIG_PSA_WANT_ALG_ECDSA=y
CONFIG_MBEDTLS_MPI_MAX_SIZE=512
CONFIG_PSA_WANT_RSA_KEY_SIZE_4096=y

# SHA-256 via PSA — used for firmware read-back integrity check.
# Likely already selected by TLS dependencies, but made explicit here
# because we call psa_hash_setup(PSA_ALG_SHA_256) directly.
CONFIG_PSA_WANT_ALG_SHA_256=y

# ── NTP / Date-Time ───────────────────────────────────────────────────────────
CONFIG_SNTP=y
CONFIG_DATE_TIME=y
CONFIG_DATE_TIME_NTP=y

# ── JSON ──────────────────────────────────────────────────────────────────────
CONFIG_JSON_LIBRARY=y

# ── CRC32 ─────────────────────────────────────────────────────────────────────
# Enables crc32_ieee_update() for streaming CRC computed during download.
# Produces identical output to Python: binascii.crc32(data) & 0xFFFFFFFF
CONFIG_CRC=y

# ── MCUboot Integration (application side) ────────────────────────────────────
# Enables boot_request_upgrade() / boot_set_confirmed() in the application.
# The bootloader itself is built as a child image by sysbuild (sysbuild.conf).
CONFIG_BOOTLOADER_MCUBOOT=y
CONFIG_IMG_MANAGER=y
CONFIG_MCUBOOT_IMG_MANAGER=y

# ── External QSPI Flash — MX25R6435F (8 MB) ──────────────────────────────────
# Nordic QSPI NOR driver for the MX25R6435F on nRF7002DK.
#
# NOTE: The nRF7002 companion IC also uses QSPI. The board DTS defines both
# on the QSPI bus using separate chip-select lines. If you see DTS build
# errors about QSPI conflicts, check build/zephyr/zephyr.dts — the external
# flash node label there is the authoritative name to use in code.
CONFIG_NORDIC_QSPI_NOR=y
CONFIG_SPI_NOR=y
CONFIG_SPI_NOR_SFDP_DEVICETREE=y
CONFIG_SPI_NOR_FLASH_LAYOUT_PAGE_SIZE=4096
# ── Flash Subsystem ───────────────────────────────────────────────────────────
CONFIG_FLASH=y
CONFIG_FLASH_MAP=y
CONFIG_FLASH_PAGE_LAYOUT=y

# stream_flash: writes firmware to the secondary slot in 4 KB chunks using a
# small RAM buffer. CONFIG_STREAM_FLASH_ERASE=y auto-erases each 4 KB sector
# just before writing it, so no separate pre-erase loop is needed.
CONFIG_STREAM_FLASH=y
CONFIG_STREAM_FLASH_ERASE=y

# ── Reboot ────────────────────────────────────────────────────────────────────
CONFIG_REBOOT=y

# ── Memory ────────────────────────────────────────────────────────────────────
CONFIG_HEAP_MEM_POOL_SIZE=49152

# Stack increased from 4096: main() now runs flash erase/write, PSA hash
# over a 512-byte read buffer, and a 4096-byte recv loop. Zephyr's flash
# drivers allocate on the stack internally — 8 KB prevents stack overflow.
CONFIG_MAIN_STACK_SIZE=8192
CONFIG_SYSTEM_WORKQUEUE_STACK_SIZE=3072
CONFIG_NET_CONNECTION_MANAGER_MONITOR_STACK_SIZE=4096
CONFIG_DATE_TIME_THREAD_STACK_SIZE=3072

# ── Logging ───────────────────────────────────────────────────────────────────
CONFIG_LOG=y
CONFIG_LOG_MODE_IMMEDIATE=y
CONFIG_LOG_BACKEND_UART=y
CONFIG_NET_LOG=n
CONFIG_DK_LIBRARY=y
CONFIG_NEWLIB_LIBC=y
CONFIG_NEWLIB_LIBC_NANO=y
# Size reductions for nrf52840dk MCUboot dual-slot builds.
CONFIG_BOOT_BANNER=n
CONFIG_NCS_BOOT_BANNER=n
CONFIG_PRINTK=y
CONFIG_CBPRINTF_NANO=y
CONFIG_LTO=y
 
```

## nrf7002dk_nrf5340_cpuapp.overlay
```dts
/ {
	chosen {
		nordic,pm-ext-flash = &mx25r64;
	};
};

&mx25r64 {
	status = "okay";
};

&qspi {
	status = "okay";
};
```

## src/main.c
```c
/*
 * OTA Firmware Update Client — Stage 8 (Periodic, semaphore + thread)
 * Target : nrf7002dk/nrf5340/cpuapp     NCS : v3.2.4
 *
 * Full pipeline (unchanged from the previous modularised version):
 *  1. Wi-Fi auto-connect (wpa_supplicant + connection manager)
 *  2. 5 s routing stabilisation
 *  3. NTP time sync  (required for TLS cert notBefore/notAfter check)
 *  4. MAC address authentication against GitHub whitelist
 *  5. HTTPS fetch of update.json  → parse 5 fields only
 *  6. Semver version check         → skip if already current
 *  7. HTTPS download of firmware binary → stream directly to QSPI secondary slot
 *     (auto-restarts from scratch, up to OTA_MAX_DOWNLOAD_ATTEMPTS times, on
 *      any download or integrity failure)
 *  8. CRC-32 verification          → computed during download, zero extra RAM
 *  9. SHA-256 verification         → read-back from QSPI flash via PSA Crypto
 * 10. boot_request_upgrade()       → test-mode swap request
 * 11. sys_reboot()                 → MCUboot swaps primary ↔ secondary on next boot
 *     New firmware must call boot_set_confirmed() or MCUboot reverts on timeout.
 *
 * NEW in Stage 8 — periodic execution:
 *   The pipeline above (steps 1-11, minus the one-time Wi-Fi/TLS/LED init
 *   which now happens once in main()) runs inside a dedicated OTA thread,
 *   gated by a semaphore (sem_ota_trigger):
 *     - sem_ota_trigger starts at count 1, so the OTA pipeline still runs
 *       immediately on boot — identical first-run behaviour to before.
 *     - A k_timer (ota_timer) is started with period OTA_INTERVAL,
 *       and on every expiry calls k_sem_give(&sem_ota_trigger) from timer
 *       (ISR) context, waking the OTA thread for the next cycle.
 *     - If the pipeline succeeds, boot_request_upgrade()+sys_reboot() fires
 *       as before and the device restarts (timer/semaphore re-init on boot).
 *     - If the pipeline fails or finds no update, the OTA thread simply
 *       loops back to k_sem_take() and sleeps until the *next* full 24 h
 *       timer expiry — no shortened retry interval after a failed cycle.
 *
 * Module map:
 *   tls_common.{c,h}    — shared TLS socket setup + root CA registration
 *   wifi_net.{c,h}      — Wi-Fi L4 connect/disconnect event handling
 *   ntp_sync.{c,h}      — NTP time sync
 *   mac_auth.{c,h}      — MAC whitelist authentication
 *   ota_manifest.{c,h}  — update.json fetch + parsing + version compare
 *   ota_download.{c,h}  — firmware download, CRC-32, SHA-256 verification
 *   sensor_iface.{c,h}  — I2C sensor polling thread (TMP117 + BMP280,
 *                         table-driven — see sensor_iface.c to add more)
 */

#include <errno.h>
#include <zephyr/kernel.h>
#include <zephyr/logging/log.h>
#include <zephyr/sys/reboot.h>
#include <zephyr/dfu/mcuboot.h>

#include "tls_common.h"
#include "wifi_net.h"
#include "ntp_sync.h"
#include "ota_manifest.h"
#include "ota_download.h"
#include "mqtt_ctrl.h"

LOG_MODULE_REGISTER(OTA_Client, LOG_LEVEL_INF);

/* ── Version ──────────────────────────────────────────────────────────────── */
#define FIRMWARE_VERSION_CURRENT  "1.1.2"

/* ── Download retry policy ───────────────────────────────────────────────── */
/* On any download or integrity-check failure, restart the firmware download
 * from byte 0 (up to this many total attempts) rather than giving up. */
#define OTA_MAX_DOWNLOAD_ATTEMPTS   3
#define OTA_RETRY_DELAY_MS          3000

#define OTA_THREAD_STACK_SIZE  4096
#define OTA_THREAD_PRIORITY    7

/*
 * sem_ota_trigger — gates the OTA worker thread.
 * Initial count 0 so the pipeline only runs when triggered by MQTT.
 */
static K_SEM_DEFINE(sem_ota_trigger, 0, 1);

void trigger_ota_update(void)
{
    LOG_INF("External trigger received. Waking up OTA thread...");
    k_sem_give(&sem_ota_trigger);
}

/* ═══════════════════════════════════════════════════════════════════════════
 * ota_run_once() — single end-to-end OTA pipeline pass.
 *
 * Identical logic to the previous main(): MAC auth → manifest fetch →
 * version check → download/verify retry loop → MCUboot upgrade request →
 * reboot. On success this function never returns (sys_reboot()). On any
 * failure or "already up to date" outcome it returns a status code so the
 * caller can simply log it and wait for the next cycle.
 *
 * Wi-Fi connect/DHCP and NTP sync are repeated on every cycle (not just at
 * boot) since the connection may have dropped between runs — same effect
 * as the original blocking calls, just re-entered each pass.
 * ═══════════════════════════════════════════════════════════════════════════ */
static int ota_run_once(void)
{
    int ret;

    /* ── 1. Ensure Wi-Fi + DHCP are up ───────────────────────────────────── */
    /*
     * NOTE: do NOT call wifi_net_wait_connected() here — that semaphore is
     * one-shot per connect event and is already consumed once at boot in
     * main(). If the link stays connected (the normal case), the event
     * never refires, so calling it again here would block this thread
     * forever on the 2nd+ cycle. Poll the persistent flag instead.
     */
    while (!wifi_net_is_connected()) {
        LOG_WRN("Wi-Fi not connected — waiting before this OTA cycle...");
        k_msleep(2000);
    }

    /* ── 2. Routing stabilisation ────────────────────────────────────────── */
    LOG_INF("Interface up. Waiting 5 s for routing to settle...");
    k_msleep(5000);

    /* ── 3. NTP time sync ────────────────────────────────────────────────── */
    ntp_sync_blocking(K_SECONDS(15));

    /* ── 4. Fetch manifest ───────────────────────────────────────────────── */
    ret = ota_manifest_fetch();
    if (ret != 0) {
        LOG_ERR("Manifest fetch failed: %d", ret);
        return ret;
    }

    const struct ota_manifest *manifest = ota_manifest_get();

    /* ── 5. Version check ────────────────────────────────────────────────── */
    if (ota_manifest_version_cmp(manifest->version, FIRMWARE_VERSION_CURRENT) <= 0) {
        LOG_INF("Already running the latest firmware (%s). Nothing to do.",
                FIRMWARE_VERSION_CURRENT);
        return 0;
    }
    LOG_INF("Update available: %s → %s",
            FIRMWARE_VERSION_CURRENT, manifest->version);

    /* ── 6-8. Download + verify, restarting from scratch on any failure ─── */
    bool update_ready = false;

    for (int attempt = 1; attempt <= OTA_MAX_DOWNLOAD_ATTEMPTS; attempt++) {
        uint32_t computed_crc   = 0;
        size_t   received_bytes = 0;

        LOG_INF("Firmware download attempt %d/%d ...",
                attempt, OTA_MAX_DOWNLOAD_ATTEMPTS);

        ret = ota_download_firmware(manifest, &computed_crc, &received_bytes);
        if (ret != 0) {
            LOG_WRN("Download attempt %d failed (%d).", attempt, ret);
            goto retry_wait;
        }

        ret = ota_download_verify_crc32(manifest, computed_crc, received_bytes);
        if (ret != 0) {
            LOG_WRN("CRC-32 check failed on attempt %d — download was "
                    "corrupted or interrupted.", attempt);
            goto retry_wait;
        }

        ret = ota_download_verify_sha256(manifest);
        if (ret != 0) {
            LOG_WRN("SHA-256 check failed on attempt %d.", attempt);
            goto retry_wait;
        }

        update_ready = true;
        break;

retry_wait:
        if (attempt < OTA_MAX_DOWNLOAD_ATTEMPTS) {
            LOG_INF("Retrying download in %d ms ...", OTA_RETRY_DELAY_MS);
            k_msleep(OTA_RETRY_DELAY_MS);
        }
    }

    if (!update_ready) {
        LOG_ERR("Firmware download/verify failed after %d attempts. "
                "Giving up until next scheduled OTA check.",
                OTA_MAX_DOWNLOAD_ATTEMPTS);
        return -EIO;
    }

    /* ── 9. Request MCUboot upgrade and reboot ───────────────────────────── */
    LOG_INF("Download verified (CRC-32 + SHA-256 OK). "
            "Requesting MCUboot upgrade...");

    ret = boot_request_upgrade(BOOT_UPGRADE_TEST);
    if (ret != 0) {
        LOG_ERR("boot_request_upgrade failed: %d", ret);
        return ret;
    }

    LOG_INF("Rebooting into new firmware in 1 s...");
    k_msleep(1000);
    sys_reboot(SYS_REBOOT_COLD);

    /* Never reached */
    return 0;
}

/* ═══════════════════════════════════════════════════════════════════════════
 * ota_thread_fn() — persistent worker thread.
 *
 * Blocks on sem_ota_trigger, runs one full OTA pass, then goes straight
 * back to waiting on the semaphore. Whether the pass succeeded, found no
 * update, or failed after retries, the next wake-up only happens via the
 * next k_sem_give() — i.e. the next full OTA_INTERVAL timer expiry. There
 * is no shortened/backoff retry interval after a failure.
 * ═══════════════════════════════════════════════════════════════════════════ */
static void ota_thread_fn(void *arg1, void *arg2, void *arg3)
{
    ARG_UNUSED(arg1);
    ARG_UNUSED(arg2);
    ARG_UNUSED(arg3);

    while (true) {
        k_sem_take(&sem_ota_trigger, K_FOREVER);

        LOG_INF("=== Starting OTA check/update cycle ===");
        int ret = ota_run_once();
        LOG_INF("=== OTA cycle finished (ret=%d). Sleeping until next "
                "scheduled check. ===", ret);
    }
}

K_THREAD_STACK_DEFINE(ota_thread_stack, OTA_THREAD_STACK_SIZE);
static struct k_thread ota_thread_data;

/* ═══════════════════════════════════════════════════════════════════════════
 * MAIN — one-time init only. Periodic OTA work happens in ota_thread_fn().
 * ═══════════════════════════════════════════════════════════════════════════ */
int main(void)
{
    int ret;

    ret = tls_common_init();
    if (ret < 0) {
        return ret;
    }

    LOG_INF("OTA Client starting. Waiting for Wi-Fi...");

    wifi_net_init();

    /* Block here once at boot so the first OTA pass (triggered by the
     * semaphore's initial count of 1) doesn't race ahead of link-up. The
     * OTA thread itself also calls wifi_net_wait_connected() on every
     * cycle, in case the link has dropped between runs. */
    wifi_net_wait_connected();

    /* ── Start the MQTT client thread ────────────────────────────────────── */
    mqtt_ctrl_start();

    /* ── Start the periodic OTA worker thread ────────────────────────────── */
    k_thread_create(&ota_thread_data,
                    ota_thread_stack,
                    K_THREAD_STACK_SIZEOF(ota_thread_stack),
                    ota_thread_fn,
                    NULL, NULL, NULL,
                    OTA_THREAD_PRIORITY,
                    0,
                    K_NO_WAIT);

    LOG_INF("OTA scheduler ready: Waiting for MQTT trigger...");

    return 0;
}
```

## src/mqtt_ctrl.c
```c
#include <zephyr/kernel.h>
#include <zephyr/logging/log.h>
#include <zephyr/net/socket.h>
#include <zephyr/net/mqtt.h>
#include <zephyr/random/random.h>
#include <string.h>

#include "mqtt_ctrl.h"

LOG_MODULE_REGISTER(mqtt_ctrl, LOG_LEVEL_INF);

/* ── Broker Configuration ────────────────────────────────────────────────── */
#define MQTT_BROKER_HOSTNAME "broker.hivemq.com"
#define MQTT_BROKER_PORT     8883
#define MQTT_TOPIC           "device/ota/cmd"

/* ── MQTT Client Data ────────────────────────────────────────────────────── */
#define MQTT_BUFFER_SIZE  128
static uint8_t rx_buffer[MQTT_BUFFER_SIZE];
static uint8_t tx_buffer[MQTT_BUFFER_SIZE];
static uint8_t payload_buf[MQTT_BUFFER_SIZE];

static struct mqtt_client client_ctx;
static struct sockaddr_storage broker_addr;
static struct mqtt_utf8 client_id;

#define MQTT_THREAD_STACK_SIZE 4096
#define MQTT_THREAD_PRIORITY   8
K_THREAD_STACK_DEFINE(mqtt_thread_stack, MQTT_THREAD_STACK_SIZE);
static struct k_thread mqtt_thread_data;

static bool connected = false;

/* External OTA trigger function defined in main.c */
extern void trigger_ota_update(void);

/* ── DNS Resolution ──────────────────────────────────────────────────────── */
static int resolve_broker(void)
{
    struct zsock_addrinfo *res;
    struct zsock_addrinfo hints = {
        .ai_family = AF_INET,
        .ai_socktype = SOCK_STREAM,
    };

    LOG_INF("Resolving %s...", MQTT_BROKER_HOSTNAME);

    int ret = zsock_getaddrinfo(MQTT_BROKER_HOSTNAME, NULL, &hints, &res);
    if (ret != 0) {
        LOG_ERR("getaddrinfo failed: %d", ret);
        return ret;
    }

    struct sockaddr_in *addr4 = (struct sockaddr_in *)&broker_addr;
    addr4->sin_family = AF_INET;
    addr4->sin_port = htons(MQTT_BROKER_PORT);
    addr4->sin_addr = ((struct sockaddr_in *)res->ai_addr)->sin_addr;

    char ipv4_str[INET_ADDRSTRLEN];
    zsock_inet_ntop(AF_INET, &addr4->sin_addr, ipv4_str, sizeof(ipv4_str));
    LOG_INF("Resolved broker to %s", ipv4_str);

    zsock_freeaddrinfo(res);
    return 0;
}

/* ── MQTT Callbacks ──────────────────────────────────────────────────────── */
static void mqtt_evt_handler(struct mqtt_client *const client,
                             const struct mqtt_evt *evt)
{
    int ret;

    switch (evt->type) {
    case MQTT_EVT_CONNACK:
        if (evt->result != 0) {
            LOG_ERR("MQTT connect failed %d", evt->result);
            break;
        }
        connected = true;
        LOG_INF("MQTT client connected!");

        /* Subscribe to OTA topic */
        struct mqtt_topic subscribe_topic = {
            .topic = {
                .utf8 = (uint8_t *)MQTT_TOPIC,
                .size = strlen(MQTT_TOPIC)
            },
            .qos = MQTT_QOS_0_AT_MOST_ONCE
        };
        const struct mqtt_subscription_list sub_list = {
            .list = &subscribe_topic,
            .list_count = 1,
            .message_id = sys_rand32_get()
        };
        ret = mqtt_subscribe(client, &sub_list);
        if (ret != 0) {
            LOG_ERR("Failed to subscribe to topic: %d", ret);
        } else {
            LOG_INF("Subscribed to topic: %s", MQTT_TOPIC);
        }
        break;

    case MQTT_EVT_DISCONNECT:
        LOG_INF("MQTT client disconnected %d", evt->result);
        connected = false;
        break;

    case MQTT_EVT_PUBLISH:
        LOG_INF("MQTT message received!");
        const struct mqtt_publish_param *pub = &evt->param.publish;
        
        size_t len = pub->message.payload.len;
        if (len < sizeof(payload_buf) - 1) {
            /* Read payload */
            ret = mqtt_read_publish_payload(client, payload_buf, len);
            if (ret >= 0) {
                payload_buf[len] = '\0';
                LOG_INF("Topic: %.*s, Payload: %s", 
                        pub->message.topic.topic.size,
                        pub->message.topic.topic.utf8,
                        payload_buf);

                /* Check for OTA trigger command */
                if (strcmp((char *)payload_buf, "git") == 0) {
                    LOG_INF("Received 'git' command. Triggering OTA update!");
                    trigger_ota_update();
                }
            } else {
                LOG_ERR("Failed to read payload: %d", ret);
            }
        } else {
            LOG_WRN("Payload too large, dropping.");
            /* Drop message */
            mqtt_read_publish_payload(client, payload_buf, sizeof(payload_buf));
        }

        /* Send ACK if QoS > 0 */
        if (pub->message.topic.qos == MQTT_QOS_1_AT_LEAST_ONCE) {
            struct mqtt_puback_param puback = {
                .message_id = pub->message_id
            };
            mqtt_publish_qos1_ack(client, &puback);
        }
        break;

    case MQTT_EVT_SUBACK:
        LOG_INF("SUBACK packet id: %u", evt->param.suback.message_id);
        break;

    default:
        LOG_INF("Unhandled MQTT event %d", evt->type);
        break;
    }
}

/* ── MQTT Client Setup and Loop ──────────────────────────────────────────── */
static void mqtt_thread_fn(void *arg1, void *arg2, void *arg3)
{
    ARG_UNUSED(arg1);
    ARG_UNUSED(arg2);
    ARG_UNUSED(arg3);

    int ret;
    char client_id_str[32];
    snprintf(client_id_str, sizeof(client_id_str), "ota_client_%08x", sys_rand32_get());

    client_id.utf8 = (uint8_t *)client_id_str;
    client_id.size = strlen(client_id_str);

    while (true) {
        if (!connected) {
            ret = resolve_broker();
            if (ret != 0) {
                k_msleep(5000);
                continue;
            }

            mqtt_client_init(&client_ctx);

            /* Setup broker address */
            client_ctx.broker = &broker_addr;
            client_ctx.evt_cb = mqtt_evt_handler;
            client_ctx.client_id = client_id;
            client_ctx.password = NULL;
            client_ctx.user_name = NULL;
            
            client_ctx.rx_buf = rx_buffer;
            client_ctx.rx_buf_size = sizeof(rx_buffer);
            client_ctx.tx_buf = tx_buffer;
            client_ctx.tx_buf_size = sizeof(tx_buffer);

            /* We use plain TCP */
            client_ctx.transport.type = MQTT_TRANSPORT_NON_SECURE;

            ret = mqtt_connect(&client_ctx);
            if (ret != 0) {
                LOG_ERR("mqtt_connect failed: %d", ret);
                k_msleep(5000);
                continue;
            }
        }

        ret = mqtt_input(&client_ctx);
        if (ret < 0) {
            LOG_ERR("mqtt_input error: %d", ret);
            mqtt_abort(&client_ctx);
            connected = false;
        }

        ret = mqtt_live(&client_ctx);
        if (ret != 0 && ret != -EAGAIN) {
            LOG_ERR("mqtt_live error: %d", ret);
            mqtt_abort(&client_ctx);
            connected = false;
        }

        k_msleep(100);
    }
}

void mqtt_ctrl_start(void)
{
    LOG_INF("Starting MQTT thread...");
    k_thread_create(&mqtt_thread_data,
                    mqtt_thread_stack,
                    K_THREAD_STACK_SIZEOF(mqtt_thread_stack),
                    mqtt_thread_fn,
                    NULL, NULL, NULL,
                    MQTT_THREAD_PRIORITY,
                    0,
                    K_NO_WAIT);
}
```

## src/mqtt_ctrl.h
```c
#ifndef MQTT_CTRL_H
#define MQTT_CTRL_H

#ifdef __cplusplus
extern "C" {
#endif

/**
 * @brief Initialize and start the MQTT client thread.
 * 
 * This function creates a thread that connects to the MQTT broker,
 * subscribes to the OTA trigger topic, and listens for the "git" command.
 * Upon receiving "git", it triggers the OTA update pipeline.
 */
void mqtt_ctrl_start(void);

#ifdef __cplusplus
}
#endif

#endif /* MQTT_CTRL_H */
```

## src/ntp_sync.c
```c
/*
 * ntp_sync.c — NTP time sync wrapper.
 *
 * on_date_time_notification() body is byte-for-byte identical to the
 * original in main.c.
 */

#include "ntp_sync.h"

#include <zephyr/logging/log.h>
#include <date_time.h>

LOG_MODULE_REGISTER(ntp_sync, LOG_LEVEL_INF);

static K_SEM_DEFINE(sem_ntp_done, 0, 1);

static void on_date_time_notification(const struct date_time_evt *evt)
{
    if (evt->type == DATE_TIME_OBTAINED_NTP) {
        LOG_INF("NTP sync successful.");
    } else {
        LOG_WRN("NTP sync failed — TLS cert time check may fail if cert "
                "window has shifted.");
    }
    k_sem_give(&sem_ntp_done);
}

void ntp_sync_blocking(k_timeout_t timeout)
{
    LOG_INF("Starting NTP sync...");
    date_time_register_handler(on_date_time_notification);
    date_time_update_async(NULL);

    if (k_sem_take(&sem_ntp_done, timeout) != 0) {
        LOG_WRN("NTP timed out — TLS cert time check may fail if cert expired");
    }
}
```

## src/ntp_sync.h
```c
#define NTP_SYNC_H

#include <zephyr/kernel.h>

/*
 * ntp_sync.h — NTP time sync wrapper.
 *
 * Extracted from main.c: on_date_time_notification(), sem_ntp_done, and
 * the date_time_register_handler() / date_time_update_async() / k_sem_take
 * sequence that was inlined in main(). Logic is unchanged; the only
 * difference is the 15-second timeout is now a function parameter instead
 * of a hardcoded K_SECONDS(15), to avoid a magic number crossing the
 * module boundary silently. Calling with the same value reproduces
 * identical behaviour.
 */

/**
 * @brief Start an NTP sync and block until it completes or times out.
 *
 * On timeout, logs the same warning the original main() logged and returns
 * normally — NTP failure is non-fatal, exactly as before.
 *
 * @param timeout  How long to wait for sync (pass K_SECONDS(15) to match
 *                 the original main.c behaviour exactly).
 */
void ntp_sync_blocking(k_timeout_t timeout);
```

## src/ota_download.c
```c
/*
 * ota_download.c — Firmware download, CRC-32, and SHA-256 verification.
 *
 * download_firmware(), verify_crc32(), verify_sha256(), open_secondary_slot(),
 * and find_body_start() bodies are byte-for-byte identical to the originals
 * in main.c. The only change is reading manifest fields through a passed-in
 * `const struct ota_manifest *manifest` parameter instead of the file-static
 * g_manifest global — same field names, same values, same access pattern,
 * just passed explicitly across the module boundary instead of shared
 * implicitly within one file.
 */

#include "ota_download.h"
#include "ota_manifest.h"
#include "tls_common.h"

#include <errno.h>
#include <stdint.h>
#include <stdio.h>
#include <stdlib.h>
#include <string.h>

#include <zephyr/kernel.h>
#include <zephyr/logging/log.h>
#include <zephyr/net/socket.h>
#include <zephyr/sys/crc.h>
#include <zephyr/storage/flash_map.h>
#include <zephyr/storage/stream_flash.h>

#include <psa/crypto.h>

LOG_MODULE_REGISTER(ota_download, LOG_LEVEL_INF);

/* ── GitHub endpoint ──────────────────────────────────────────────────────── */
#define GITHUB_HOST    "raw.githubusercontent.com"
#define GITHUB_PORT    "443"

/*
 * Firmware download recv buffer: 4 KB matches the MX25R6435F sector.
 * Stored in BSS (no flash cost, only RAM). With 512 KB RAM this is fine.
 */
#define FW_RECV_BUF_SIZE       4096
/* stream_flash internal buffer: must equal or be a multiple of the erase unit. */
#define STREAM_FLASH_BUF_SIZE  4096

/* ── Flash context (global — too large for stack) ────────────────────────── */
static struct stream_flash_ctx g_fw_stream;
static uint8_t                 g_stream_buf[STREAM_FLASH_BUF_SIZE];
static const struct flash_area *g_fw_fa;

/* ── Firmware download recv buffer ───────────────────────────────────────── */
static uint8_t fw_recv_buf[FW_RECV_BUF_SIZE];

static const uint8_t *find_body_start(const uint8_t *buf, size_t len)
{
    for (size_t i = 0; (i + 3) < len; i++) {
        if (buf[i]   == '\r' && buf[i+1] == '\n' &&
            buf[i+2] == '\r' && buf[i+3] == '\n') {
            return buf + i + 4;
        }
    }
    return NULL;
}

static int open_secondary_slot(void)
{
    int ret = flash_area_open(FIXED_PARTITION_ID(mcuboot_secondary), &g_fw_fa);
    if (ret != 0) {
        LOG_ERR("flash_area_open(mcuboot_secondary) failed: %d. "
                "Verify PM_MCUBOOT_SECONDARY_ID in pm_config.h", ret);
        return ret;
    }

    const struct device *flash_dev = flash_area_get_device(g_fw_fa);
    if (!device_is_ready(flash_dev)) {
        LOG_ERR("QSPI flash device not ready. "
                "Check CONFIG_NORDIC_QSPI_NOR=y and board DTS node.");
        flash_area_close(g_fw_fa);
        return -ENODEV;
    }

    ret = stream_flash_init(&g_fw_stream,
                            flash_dev,
                            g_stream_buf,
                            sizeof(g_stream_buf),
                            g_fw_fa->fa_off,
                            g_fw_fa->fa_size,
                            NULL);
    if (ret != 0) {
        LOG_ERR("stream_flash_init failed: %d", ret);
        flash_area_close(g_fw_fa);
    }
    return ret;
}

/*
 * Each call starts completely fresh: re-opens the secondary slot, re-inits
 * stream_flash, and re-downloads from byte 0. CONFIG_STREAM_FLASH_ERASE=y
 * re-erases each 4 KB sector before writing, so calling this repeatedly
 * from main()'s retry loop after a failed/interrupted attempt is safe.
 */
int ota_download_firmware(const struct ota_manifest *manifest,
                          uint32_t *out_crc, size_t *out_bytes)
{
    int ret = open_secondary_slot();
    if (ret != 0) {
        return ret;
    }

    int sock = tls_common_open_socket(GITHUB_HOST, GITHUB_PORT);
    if (sock < 0) {
        flash_area_close(g_fw_fa);
        return sock;
    }

    char req[384];
    int  req_len = snprintf(req, sizeof(req),
        "GET %s HTTP/1.0\r\n"
        "Host: %s\r\n"
        "\r\n",
        manifest->fw_path, GITHUB_HOST);

    if (send(sock, req, req_len, 0) < 0) {
        LOG_ERR("firmware GET send() failed, errno %d", errno);
        close(sock);
        flash_area_close(g_fw_fa);
        return -errno;
    }

    LOG_INF("Downloading firmware from %s ...", manifest->fw_path);

    uint32_t running_crc    = 0;
    size_t   bytes_written  = 0;
    bool     headers_skipped = false;
    int      n;

    while (true) {
        n = recv(sock, fw_recv_buf, sizeof(fw_recv_buf), 0);
        if (n < 0) {
            LOG_ERR("firmware recv() failed, errno %d", errno);
            ret = -errno;
            goto cleanup;
        }
        if (n == 0) {
            break;
        }

        const uint8_t *data     = fw_recv_buf;
        size_t         data_len = (size_t)n;

        if (!headers_skipped) {
            const uint8_t *body = find_body_start(fw_recv_buf, data_len);
            if (!body) {
                continue;
            }
            headers_skipped = true;
            data_len = data_len - (size_t)(body - fw_recv_buf);
            data     = body;
            LOG_INF("HTTP headers consumed. Firmware data starting.");
        }

        if (data_len == 0) {
            continue;
        }

        ret = stream_flash_buffered_write(&g_fw_stream, data, data_len, false);
        if (ret != 0) {
            LOG_ERR("stream_flash write failed at offset %zu: %d",
                    bytes_written, ret);
            goto cleanup;
        }

        running_crc   = crc32_ieee_update(running_crc, data, data_len);
        bytes_written += data_len;
    }

    ret = stream_flash_buffered_write(&g_fw_stream, NULL, 0, true);
    if (ret != 0) {
        LOG_ERR("stream_flash flush failed: %d", ret);
        goto cleanup;
    }

    LOG_INF("Download complete: %zu bytes written to QSPI secondary slot",
            bytes_written);
    *out_crc   = running_crc;
    *out_bytes = bytes_written;
    ret = 0;

cleanup:
    close(sock);
    flash_area_close(g_fw_fa);
    return ret;
}

int ota_download_verify_crc32(const struct ota_manifest *manifest,
                              uint32_t computed, size_t received_bytes)
{
    if ((int)received_bytes != manifest->file_size) {
        LOG_ERR("File size mismatch: received %zu bytes, manifest says %d",
                received_bytes, manifest->file_size);
        return -EMSGSIZE;
    }

    uint32_t expected = (uint32_t)strtoul(manifest->crc32, NULL, 16);
    if (computed != expected) {
        LOG_ERR("CRC32 FAIL — computed 0x%08X, expected 0x%08X",
                computed, expected);
        return -EBADMSG;
    }

    LOG_INF("CRC32 OK: 0x%08X", computed);
    return 0;
}

int ota_download_verify_sha256(const struct ota_manifest *manifest)
{
    int ret = flash_area_open(FIXED_PARTITION_ID(mcuboot_secondary), &g_fw_fa);
    if (ret != 0) {
        LOG_ERR("Cannot open secondary slot for SHA-256 read-back: %d", ret);
        return ret;
    }

    psa_hash_operation_t op  = PSA_HASH_OPERATION_INIT;
    psa_status_t         psa = psa_hash_setup(&op, PSA_ALG_SHA_256);
    if (psa != PSA_SUCCESS) {
        LOG_ERR("psa_hash_setup failed: %d", psa);
        flash_area_close(g_fw_fa);
        return -EIO;
    }

    uint8_t read_buf[512];
    size_t  remaining = (size_t)manifest->file_size;
    size_t  offset    = 0;

    while (remaining > 0) {
        size_t to_read = MIN(remaining, sizeof(read_buf));

        ret = flash_area_read(g_fw_fa, offset, read_buf, to_read);
        if (ret != 0) {
            LOG_ERR("flash_area_read at offset %zu failed: %d", offset, ret);
            psa_hash_abort(&op);
            flash_area_close(g_fw_fa);
            return ret;
        }

        psa_hash_update(&op, read_buf, to_read);
        offset    += to_read;
        remaining -= to_read;
    }

    flash_area_close(g_fw_fa);

    uint8_t hash[32];
    size_t  hash_len;

    psa = psa_hash_finish(&op, hash, sizeof(hash), &hash_len);
    if (psa != PSA_SUCCESS) {
        LOG_ERR("psa_hash_finish failed: %d", psa);
        return -EIO;
    }

    char hash_str[65];
    for (int i = 0; i < 32; i++) {
        snprintf(&hash_str[i * 2], 3, "%02x", hash[i]);
    }
    hash_str[64] = '\0';

    if (strcmp(hash_str, manifest->sha256) != 0) {
        LOG_ERR("SHA-256 FAIL");
        LOG_ERR("  computed : %s", hash_str);
        LOG_ERR("  expected : %s", manifest->sha256);
        return -EBADMSG;
    }

    LOG_INF("SHA-256 OK: %s", hash_str);
    return 0;
}
```

## src/ota_download.h
```c
#define OTA_DOWNLOAD_H

#include <stddef.h>
#include <stdint.h>

/*
 * ota_download.h — Firmware download to QSPI secondary slot, CRC-32 and
 * SHA-256 verification.
 *
 * Extracted from main.c: open_secondary_slot(), download_firmware(),
 * verify_crc32(), verify_sha256(), find_body_start(), and the associated
 * static buffers (g_fw_stream, g_stream_buf, g_fw_fa, fw_recv_buf).
 * All logic identical to the original.
 *
 * download_firmware() and verify_crc32()/verify_sha256() now take a
 * `const struct ota_manifest *manifest` parameter instead of reading the
 * file-static g_manifest directly — this is the one intentional design
 * change recommended during the modularisation discussion (explicit
 * dependency instead of implicit global), not a behavioural change: the
 * exact same fields (fw_path, file_size, sha256, crc32) are read in the
 * exact same way.
 */

struct ota_manifest; /* forward declaration — full definition in ota_manifest.h */

/**
 * @brief Download the firmware binary named in manifest->fw_path to the
 * QSPI secondary slot, computing CRC-32 incrementally as data arrives.
 *
 * Each call starts completely fresh: re-opens the secondary slot, re-inits
 * stream_flash, and re-downloads from byte 0 — identical behaviour to the
 * original, safe to call repeatedly from a retry loop.
 *
 * @param manifest   Parsed manifest (must have fw_path set).
 * @param out_crc    Receives the CRC-32 of all bytes written.
 * @param out_bytes  Receives the total byte count written.
 * @return 0 on success, negative errno on failure.
 */
int ota_download_firmware(const struct ota_manifest *manifest,
                          uint32_t *out_crc, size_t *out_bytes);

/**
 * @brief Verify the CRC-32 computed during download against the manifest.
 *
 * Identical to the original verify_crc32(): also checks received_bytes
 * against manifest->file_size before comparing the CRC value.
 *
 * @return 0 on match, -EMSGSIZE on size mismatch, -EBADMSG on CRC mismatch.
 */
int ota_download_verify_crc32(const struct ota_manifest *manifest,
                              uint32_t computed, size_t received_bytes);

/**
 * @brief Verify SHA-256 by reading back the firmware from QSPI flash.
 *
 * Identical to the original verify_sha256(): PSA Crypto read-back in
 * 512-byte chunks, hex-compared against manifest->sha256.
 *
 * @return 0 on match, -EBADMSG on hash mismatch, other negative errno on
 *         flash/PSA error.
 */
int ota_download_verify_sha256(const struct ota_manifest *manifest);
```

## src/ota_manifest.c
```c
/*
 * ota_manifest.c — OTA manifest fetch and parsing.
 *
 * fetch logic, header/body splitting, truncation guard, and bitmask
 * validation are byte-for-byte identical to the original fetch_manifest()
 * in main.c. Only the function name (ota_manifest_fetch) and the addition
 * of ota_manifest_get() / ota_manifest_version_cmp() wrappers are new —
 * no behavioural change.
 */

#include "ota_manifest.h"
#include "tls_common.h"

#include <errno.h>
#include <stdio.h>
#include <string.h>

#include <zephyr/kernel.h>
#include <zephyr/logging/log.h>
#include <zephyr/net/socket.h>
#include <zephyr/data/json.h>

LOG_MODULE_REGISTER(ota_manifest, LOG_LEVEL_INF);

/* ── GitHub endpoint ──────────────────────────────────────────────────────── */
#define GITHUB_HOST    "raw.githubusercontent.com"
#define GITHUB_PORT    "443"
#define MANIFEST_PATH  "/BareMetalBits/OTA_Nordic_Server/main/update.json"

/*
 * Manifest buffer holds the ENTIRE HTTP response — headers + body.
 * raw.githubusercontent.com (GitHub/Fastly CDN) routinely sends 700-1000+
 * bytes of response headers ahead of the ~230 byte update.json body.
 * 2048 bytes leaves comfortable headroom for both.
 */
#define MANIFEST_BUF_SIZE  2048

static const struct json_obj_descr manifest_descr[] = {
    JSON_OBJ_DESCR_PRIM(struct ota_manifest, version,   JSON_TOK_STRING),
    JSON_OBJ_DESCR_PRIM(struct ota_manifest, file_size, JSON_TOK_NUMBER),
    JSON_OBJ_DESCR_PRIM(struct ota_manifest, fw_path,   JSON_TOK_STRING),
    JSON_OBJ_DESCR_PRIM(struct ota_manifest, sha256,    JSON_TOK_STRING),
    JSON_OBJ_DESCR_PRIM(struct ota_manifest, crc32,     JSON_TOK_STRING),
};

static struct ota_manifest g_manifest;
static char manifest_raw[MANIFEST_BUF_SIZE];

int ota_manifest_fetch(void)
{
    int sock = tls_common_open_socket(GITHUB_HOST, GITHUB_PORT);
    if (sock < 0) {
        return sock;
    }

    char req[256];
    int  req_len = snprintf(req, sizeof(req),
        "GET %s HTTP/1.1\r\n"
        "Host: %s\r\n"
        "Connection: close\r\n"
        "\r\n",
        MANIFEST_PATH, GITHUB_HOST);

    if (send(sock, req, req_len, 0) < 0) {
        LOG_ERR("manifest send() failed, errno %d", errno);
        close(sock);
        return -errno;
    }

    size_t total = 0;
    int    n;
    bool   peer_closed = false;

    memset(manifest_raw, 0, sizeof(manifest_raw));

    while (total < sizeof(manifest_raw) - 1) {
        n = recv(sock, manifest_raw + total,
                 sizeof(manifest_raw) - 1 - total, 0);
        if (n < 0) {
            LOG_ERR("manifest recv() failed, errno %d", errno);
            close(sock);
            return -errno;
        }
        if (n == 0) {
            peer_closed = true;
            break; /* server closed connection — all data received */
        }
        total += n;
    }
    close(sock);

    if (!peer_closed) {
        /* Buffer filled before the server sent a clean close — the
         * response is almost certainly truncated. Fail loudly instead of
         * letting json_obj_parse() guess. */
        LOG_WRN("manifest_raw filled (%zu bytes) before the connection "
                "closed — response is likely truncated. Increase "
                "MANIFEST_BUF_SIZE if this keeps happening.", total);
    }

    /* Separate headers from body. */
    char *body = strstr(manifest_raw, "\r\n\r\n");
    if (!body) {
        LOG_ERR("No HTTP body separator in manifest response");
        return -EPROTO;
    }
    body += 4;
    size_t body_len = total - (size_t)(body - manifest_raw);

    /* Full raw body is only useful for deep debugging — keep it out of the
     * normal terminal output by logging at DBG level. */
    LOG_DBG("Manifest body (%zu bytes):\n%s", body_len, body);

    memset(&g_manifest, 0, sizeof(g_manifest));
    int ret = json_obj_parse(body, body_len,
                             manifest_descr, ARRAY_SIZE(manifest_descr),
                             &g_manifest);
    if (ret < 0) {
        LOG_ERR("JSON parse failed: %d", ret);
        return ret;
    }

    /* json_obj_parse() returns a bitmask of which descriptors were found.
     * A successful return code doesn't guarantee every field was present —
     * confirm all 5 bits are set before trusting the manifest. */
    const int all_fields = (1 << ARRAY_SIZE(manifest_descr)) - 1;
    if (ret != all_fields) {
        LOG_ERR("Manifest missing field(s) — parsed mask 0x%x, expected 0x%x",
                ret, all_fields);
        return -EPROTO;
    }

    LOG_INF("version : %s", g_manifest.version);
    LOG_INF("fw_path : %s", g_manifest.fw_path);
    LOG_INF("sha256  : %s", g_manifest.sha256);
    LOG_INF("crc32   : %s", g_manifest.crc32);

    return 0;
}

const struct ota_manifest *ota_manifest_get(void)
{
    return &g_manifest;
}

int ota_manifest_version_cmp(const char *a, const char *b)
{
    int am = 0, an = 0, ap = 0;
    int bm = 0, bn = 0, bp = 0;

    sscanf(a, "%d.%d.%d", &am, &an, &ap);
    sscanf(b, "%d.%d.%d", &bm, &bn, &bp);

    if (am != bm) { return am - bm; }
    if (an != bn) { return an - bn; }
    return ap - bp;
}
```

## src/ota_manifest.h
```c
#define OTA_MANIFEST_H

/*
 * ota_manifest.h — OTA manifest (update.json) fetch and parsing.
 *
 * Extracted from main.c: struct ota_manifest, manifest_descr[],
 * manifest_raw[], g_manifest, find_body_start(), version_cmp(),
 * fetch_manifest(). All logic identical to the original.
 *
 * struct ota_manifest is exposed here (not kept private) because both
 * main.c (version_cmp against FIRMWARE_VERSION_CURRENT) and
 * ota_download.c (fw_path, file_size, sha256, crc32) need direct field
 * access — exactly the same fields g_manifest exposed before the split.
 */

/*
 * IMPORTANT: the string fields below are `const char *`, NOT fixed arrays.
 * Zephyr's json_obj_parse() does not copy strings — decode_string() just
 * NUL-terminates the value in place inside the internal manifest_raw[]
 * buffer and stores a POINTER to it in the destination field. Because that
 * buffer is `static` inside ota_manifest.c, it lives for the program's
 * lifetime, so these pointers stay valid after ota_manifest_fetch() returns.
 */
struct ota_manifest {
    const char *version;
    int         file_size;
    const char *fw_path;
    const char *sha256;
    const char *crc32;
};

/**
 * @brief Fetch and parse update.json from GitHub over TLS.
 *
 * Identical behaviour to the original fetch_manifest(): HTTP/1.1 GET with
 * Connection: close, truncation guard via peer_closed tracking, 5-field
 * bitmask validation after json_obj_parse().
 *
 * On success, the manifest fields are accessible via ota_manifest_get().
 *
 * @return 0 on success, negative errno on failure (-EIO, -EPROTO, parser
 *         error codes from json_obj_parse).
 */
int ota_manifest_fetch(void);

/**
 * @brief Get a pointer to the most recently fetched manifest.
 *
 * Valid only after a successful ota_manifest_fetch() call. The returned
 * pointer references static storage inside ota_manifest.c — do not free it,
 * and treat it as read-only.
 *
 * @return Pointer to the internal manifest struct.
 */
const struct ota_manifest *ota_manifest_get(void);

/**
 * @brief Compare two "MAJOR.MINOR.PATCH" version strings.
 *
 * Identical to the original version_cmp() in main.c.
 *
 * @return > 0 if a > b, 0 if equal, < 0 if a < b.
 */
int ota_manifest_version_cmp(const char *a, const char *b);
```

## src/tls_common.c
```c
/*
 * tls_common.c — Shared TLS socket setup.
 *
 * Body of tls_common_open_socket() is byte-for-byte identical to the
 * original open_tls_socket() in main.c. tls_common_init() is byte-for-byte
 * identical to the tls_credential_delete()/tls_credential_add() block that
 * was previously inlined at the top of main(). ota_root_ca[] is unchanged.
 */

#include "tls_common.h"

#include <errno.h>
#include <string.h>

#include <zephyr/kernel.h>
#include <zephyr/logging/log.h>
#include <zephyr/net/net_if.h>
#include <zephyr/net/socket.h>
#include <zephyr/net/tls_credentials.h>

LOG_MODULE_REGISTER(tls_common, LOG_LEVEL_INF);

/* ── ISRG Root X1 — Root CA for raw.githubusercontent.com ────────────────── */
static const char ota_root_ca[] =
    "-----BEGIN CERTIFICATE-----\n"
    "MIIFazCCA1OgAwIBAgIRAIIQz7DSQONZRGPgu2OCiwAwDQYJKoZIhvcNAQELBQAw\n"
    "TzELMAkGA1UEBhMCVVMxKTAnBgNVBAoTIEludGVybmV0IFNlY3VyaXR5IFJlc2Vh\n"
    "cmNoIEdyb3VwMRUwEwYDVQQDEwxJU1JHIFJvb3QgWDEwHhcNMTUwNjA0MTEwNDM4\n"
    "WhcNMzUwNjA0MTEwNDM4WjBPMQswCQYDVQQGEwJVUzEpMCcGA1UEChMgSW50ZXJu\n"
    "ZXQgU2VjdXJpdHkgUmVzZWFyY2ggR3JvdXAxFTATBgNVBAMTDElTUkcgUm9vdCBY\n"
    "MTCCAiIwDQYJKoZIhvcNAQEBBQADggIPADCCAgoCggIBAK3oJHP0FDfzm54rVygc\n"
    "h77ct984kIxuPOZXoHj3dcKi/vVqbvYATyjb3miGbESTtrFj/RQSa78f0uoxmyF+\n"
    "0TM8ukj13Xnfs7j/EvEhmkvBioZxaUpmZmyPfjxwv60pIgbz5MDmgK7iS4+3mX6U\n"
    "A5/TR5d8mUgjU+g4rk8Kb4Mu0UlXjIB0ttov0DiNewNwIRt18jA8+o+u3dpjq+sW\n"
    "T8KOEUt+zwvo/7V3LvSye0rgTBIlDHCNAymg4VMk7BPZ7hm/ELNKjD+Jo2FR3qyH\n"
    "B5T0Y3HsLuJvW5iB4YlcNHlsdu87kGJ55tukmi8mxdAQ4Q7e2RCOFvu396j3x+UC\n"
    "B5iPNgiV5+I3lg02dZ77DnKxHZu8A/lJBdiB3QW0KtZB6awBdpUKD9jf1b0SHzUv\n"
    "KBds0pjBqAlkd25HN7rOrFleaJ1/ctaJxQZBKT5ZPt0m9STJEadao0xAH0ahmbWn\n"
    "OlFuhjuefXKnEgV4We0+UXgVCwOPjdAvBbI+e0ocS3MFEvzG6uBQE3xDk3SzynTn\n"
    "jh8BCNAw1FtxNrQHusEwMFxIt4I7mKZ9YIqioymCzLq9gwQbooMDQaHWBfEbwrb\n"
    "wqHyGO0aoSCqI3Haadr8faqU9GY/rOPNk3sgrDQoo//fb4hVC1CLQJ13hef4Y53C\n"
    "IrU7m2Ys6xt0nUW7/vGT1M0NPAgMBAAGjQjBAMA4GA1UdDwEB/wQEAwIBBjAPBg\n"
    "NVHRMBAf8EBTADAQH/MB0GA1UdDgQWBBR5tFnme7bl5AFzgAiIyBpY9umbbjANBg\n"
    "kqhkiG9w0BAQsFAAOCAgEAVR9YqbyyqFDQDLHYGmkgJykIrGF1XIpu+ILlaS/V9\n"
    "lZLubhzEFnTIZd+50xx+7LSYK05qAvqFyFWhfFQDlnrzuBZ6brJFe+GnY+EgPbk6\n"
    "ZGQ3BebYhtF8GaV0nxvwuo77x/Py9auJ/GpsMiu/X1+mvoiBOv/2X/qkSsisRcOj\n"
    "/KKNFtY2PwByVS5uCbMiogziUwthDyC3+6WVwW6LLv3xLfHTjuCvjHIInNzktHCg\n"
    "KQ5ORAzI4JMPJ+GslWYHb4phowim57iaztXOoJwTdwJx4nLCgdNbOhdjsnvzqvHu\n"
    "7UrTkXWStAmzOVyyghqpZXjFaH3pO3JLF+l+/+sKAIuvtd7u+Nxe5AW0wdeRlN8N\n"
    "wdCjNPElpzVmbUq4JUagEiuTDkHzsxHpFKVK7q4+63SM1N95R1NbdWhscdCb+ZAJ\n"
    "zVcoyi3B43njTOQ5yOf+1CceWxG1bQVs5ZufpsMljq4Ui0/1lvh+wjChP4kqKOJ2\n"
    "qxq4RgqsahDYVvTH9w7jXbyLeiNdd8XM2w9U/t7y0Ff/9yi0GE44Za4rF2LN9d11\n"
    "TPAmRGunUHBcnWEvgJBQl9nJEiU0Zsnvgc/ubhPgXRR4Xq37Z0j4r7g1SgEEzwxA\n"
    "57demyPxgcYxn/eR44/KJ4EBs+lVDR3veyJm+kXQ99b21/+jh5Xos1AnX5iItreG\n"
    "Cc=\n"
    "-----END CERTIFICATE-----\n";

int tls_common_init(void)
{
    tls_credential_delete(OTA_TLS_SEC_TAG, TLS_CREDENTIAL_CA_CERTIFICATE);
    int ret = tls_credential_add(OTA_TLS_SEC_TAG, TLS_CREDENTIAL_CA_CERTIFICATE,
                                 ota_root_ca, sizeof(ota_root_ca));
    if (ret < 0) {
        LOG_ERR("tls_credential_add failed: %d", ret);
    }
    return ret;
}

int tls_common_open_socket(const char *host, const char *port)
{
    struct addrinfo hints = {
        .ai_family   = AF_INET,
        .ai_socktype = SOCK_STREAM,
        .ai_protocol = IPPROTO_TCP,
    };
    struct addrinfo *res = NULL;

    int ret = getaddrinfo(host, port, &hints, &res);
    if (ret != 0) {
        LOG_ERR("DNS lookup failed for %s: %d", host, ret);
        return -EIO;
    }

    int sock = socket(AF_INET, SOCK_STREAM, IPPROTO_TLS_1_2);
    if (sock < 0) {
        LOG_ERR("TLS socket create failed, errno %d", errno);
        freeaddrinfo(res);
        return -errno;
    }

    sec_tag_t sec_tags[] = { OTA_TLS_SEC_TAG };
    setsockopt(sock, SOL_TLS, TLS_SEC_TAG_LIST,
               sec_tags, sizeof(sec_tags));

    setsockopt(sock, SOL_TLS, TLS_HOSTNAME,
               host, strlen(host));

    int verify = TLS_PEER_VERIFY_REQUIRED;
    setsockopt(sock, SOL_TLS, TLS_PEER_VERIFY,
               &verify, sizeof(verify));

    ret = connect(sock, res->ai_addr, res->ai_addrlen);
    freeaddrinfo(res);

    if (ret < 0) {
        LOG_ERR("TLS connect to %s:%s failed, errno %d", host, port, errno);
        close(sock);
        return -errno;
    }

    LOG_INF("TLS connected to %s", host);
    return sock;
}
```
